## techpack/Kconfig
```kconfig
menu "Tech packages"

source "techpack/data/Kconfig"

source "techpack/billie/Kconfig"

endmenu
```

## techpack/oneplus/Kconfig
```kconfig
source "techpack/oneplus/coretech/Kconfig"
source "techpack/oneplus/input/Kconfig"
source "techpack/oneplus/fs/Kconfig"
source "techpack/oneplus/kernel/Kconfig"
source "techpack/oneplus/misc/Kconfig"
#source "techpack/oneplus/vibrator/Kconfig"
source "techpack/oneplus/power/Kconfig"
source "techpack/oneplus/vibrator/Kconfig"
#source "techpack/oneplus/power/Kconfig"
source "techpack/oneplus/oneplus_healthinfo/Kconfig"
source "techpack/oneplus/mm/Kconfig"
source "techpack/oneplus/opslalib/Kconfig"
#source "techpack/oneplus/framework/Kconfig"
source "techpack/oneplus/vl53L1/Kconfig"
source "techpack/oneplus/op_freezer/Kconfig"
source "techpack/oneplus/hung_task_enhance/Kconfig"
source "techpack/oneplus/wt_sys/Kconfig"
```
